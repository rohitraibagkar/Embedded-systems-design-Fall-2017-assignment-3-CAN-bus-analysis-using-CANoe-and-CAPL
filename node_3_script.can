/*@!Encoding:1252*/
includes
{
  /* Not including any library now... */
}

variables
{
  message Msg_3 Msg_3;
  dword RN3;
  int rec1;
  dword org_r1;
  timer T2;
  msTimer T3;
}

on timer T2
{
  rec1 = rec1 + RN3;
  setTimer(T2, RN3);
  if (rec1 >= 25)
  {
    setTimer(T3, 1400);
    cancelTimer(T2);
    write("R1 afer increment is >= 25");
  }
  write("Received R1 = %d", rec1);
}

on message Msg_1
{
  org_r1 = this.byte(0);
  rec1 = this.byte(1);
  if (this.byte(1) == 3)
  {
    write("R1 is %d", org_r1);
    RN3 = random(3) + 1;
    write("RN3 generated by N3 by which R1 will be incremented is %d", RN3);
    setTimer(T2, RN3);
  }
  if (this.byte(1) == 0)
  {
    cancelTimer(T2); cancelTimer(T3);
  }
}

on timer T3
{
  Msg_3.byte(0) = org_r1 + 1;
  output(Msg_3);
}

