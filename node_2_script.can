/*@!Encoding:1252*/
includes
{
  /* Not including any library now... */
}

variables
{
  message Msg_2 Msg_2;
  dword RN2;
  int rec1;
  dword org_r1;
  timer T2;
  msTimer T3;
}

on message Msg_1
{
  org_r1 = this.byte(0);
  rec1 = this.byte(0);
  if (this.byte(1) == 2)
  {
    write("R1 is %d", org_r1);
    
    RN2 = random(4) + 1;
    write("RN2 generated by N2 by which R1 will be incremented is %d", RN2);
    setTimer(T2, RN2);
  }
  
  if (this.byte(1) == 0)
  {
    cancelTimer (T2); cancelTimer (T3);
  }
}

on timer T2
{
  rec1 = rec1 + RN2;
  setTimer(T2, RN2);
  
  if (rec1 >= 25)
  {
    setTimer(T3, 1400);
    cancelTimer(T2);
    write("R1 after increment is >= 25");
  }
  write("Received R1 = %d", rec1);
}

on timer T3
{
  Msg_2.byte(0) = org_r1 + 1;
  output(Msg_2);
}

