VERSION ""

NS_ :

BS_:

BU_: Node_3 Node_2 Node_1

BO_ 2 Msg_3: 1 Node_3
 SG_ Signal_4 : 0|8@1- (1,0) [0|0] "" Vector__XXX

BO_ 1 Msg_2: 1 Node_2
 SG_ Signal_3 : 0|8@1- (1,0) [0|0] "" Vector__XXX

BO_ 0 Msg_1: 2 Node_1
 SG_ Signal_2 : 8|8@1- (1,0) [0|0] "" Vector__XXX
 SG_ Signal_1 : 0|8@1- (1,0) [0|0] "" Vector__XXX

EV_ R2: 0 [0|0] "" 0 1 DUMMY_NODE_VECTOR0 Vector__XXX;

EV_ R1: 0 [0|0] "" 0 2 DUMMY_NODE_VECTOR0 Vector__XXX;

EV_ EvarSwich: 0 [0|0] "" 0 3 DUMMY_NODE_VECTOR0 Vector__XXX;
